* ===================================================================
*             MAPA DE SIMBOLOS DA ROM DO COMPUTADOR PDS317            
*              (Gerado automaticamente via gera_includes.py)         
* ===================================================================

xmodemReceive                EQU   $8034
xmodemTransmit               EQU   $8036
delay                        EQU   $8074
mymemset                     EQU   $808C
init_uart                    EQU   $80A4
read_kbd                     EQU   $80D0
uart_read                    EQU   $80E0
write_kbd                    EQU   $80E2
get_0x81                     EQU   $80F6
get_0x87                     EQU   $8162
set_keyboard_leds            EQU   $8188
get_0x88                     EQU   $81F6
get_packet                   EQU   $8296
reset_por_software           EQU   $8302
set_transparent_mode         EQU   $830A
get_kbd_key                  EQU   $8348
get_key                      EQU   $847E
